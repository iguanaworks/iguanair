; Generated by PSoC Designer ver 4.2  b1013 : 02 September, 2004
;
;
;	This file contains equates to support oscillator register initialization
;      for CY7C63813-PXC
;

CPU_CLOCK:				equ	0h	;CPU Clock value
CPU_CLOCK_MASK:			equ	1h 	;CPU Clock mask
CPU_CLOCK_JUST:			equ	0h 	;CPU Clock value justified

CPU_CLOCK_SPEED:		equ	3h	;CPU Clock Speed value
CPU_CLOCK_SPEED_MASK: 	equ	3h	;CPU Clock Speed mask
CPU_CLOCK_SPEED_JUST:  	equ	3h	;CPU Clock Speed value justified

TIMER_CLOCK: 			equ	3h	;Timer Clock value
TIMER_CLOCK_MASK:		equ	3h	;Timer Clock mask
TIMER_CLOCK_JUST:		equ	3h	;Timer Clock value justified

TIMER_CLOCK_SPEED:		equ	3h	;Timer clock speed value
TIMER_CLOCK_SPEED_MASK:	equ	ch	;Timer clock speed mask
TIMER_CLOCK_SPEED_JUST:	equ	ch	;Timer clock speed value justified

CAPT_CLOCK: 			equ	0h	;Capture Clock value
CAPT_CLOCK_MASK:		equ	30h	;Capture Clock mask
CAPT_CLOCK_JUST:		equ	0h	;Capture Clock value justified

CAPT_CLOCK_SPEED: 	  	equ	2h	;Capture Clock speed value
CAPT_CLOCK_SPEED_MASK:	equ	c0h	;Capture Clock speed mask
CAPT_CLOCK_SPEED_JUST: 	equ	80h	;Capture Clock speed value justified

CAPT_EDGE: 				equ	0h	;Capture Edge value
CAPT_EDGE_MASK:			equ	80h	;Capture Edge mask
CAPT_EDGE_JUST:			equ	0h	;Capture Edge value justified

CAPT_PRESCALE: 		 	equ	0h	;Capture Prescale value
CAPT_PRESCALE_MASK:		equ	70h	;Capture Prescale mask
CAPT_PRESCALE_JUST:	 	equ	0h	;Capture Prescale value justified

USB_CLOCK:				equ	0h	;USB Clock source value
USB_CLOCK_MASK:			equ	20h	;USB Clock source mask
USB_CLOCK_JUST:			equ	0h	;USB Clock source justified

USB_CLOCK_SPEED:	  	equ	0h	;USB Clock div by 2 value
USB_CLOCK_SPEED_MASK: 	equ	40h	;USB Clock div by 2 mask
USB_CLOCK_SPEED_JUST: 	equ	0h	;USB Clock div by 2 justified

CLOCK_OUT:				equ	0h  ;Clock Out value
CLOCK_OUT_MASK:			equ	3h	;Clock Out mask
CLOCK_OUT_JUST:			equ	0h 	;Clock Out value justified

LV_DETECT_LEVEL:		equ	4h	;Low V Detect Level value
LV_DETECT_LEVEL_MASK:	equ	7h	;Low V Detect Level mask
LV_DETECT_LEVEL_JUST:	equ	4h	;Low V Detect Level value justified

PWR_ON_RESET_LEVEL:   	 	equ	1h	;PowerOn Reset Level value
PWR_ON_RESET_LEVEL_MASK:	equ	30h	;PowerOn Reset Level mask
PWR_ON_RESET_LEVEL_JUST:	equ	10h	;PowerOn Reset Level value justified

VREG_ENABLE: 	   		equ	0h  ;VREG Enable value
VREG_ENABLE_MASK:		equ	1h	;VREG Enable mask
VREG_ENABLE_JUST:		equ	0h	;VREG Enable value justified

KEEP_ALIVE: 	   		equ	0h	;Keep Alive value
KEEP_ALIVE_MASK:		equ	2h	;Keep Alive mask
KEEP_ALIVE_JUST:		equ	0h	;Keep Alive value justified

WATCHDOG_ENABLE: 	   	equ	0h	;Watchdog Enable value
